## platform/cnss2/autogvm_gki_defconfig
```kconfig
CONFIG_CNSS_OUT_OF_TREE=y
CONFIG_CNSS2=m
CONFIG_CNSS2_QMI=y
CONFIG_CNSS_PLAT_IPC_QMI_SVC=m
CONFIG_CNSS2_DEBUG=y
CONFIG_CNSS2_ENUM_WITH_LOW_SPEED=y
CONFIG_CNSS2_CONDITIONAL_POWEROFF=y
CONFIG_WCNSS_MEM_PRE_ALLOC=m
CONFIG_CNSS_SUPPORT_DUAL_DEV=y
```

## platform/cnss_prealloc/Kconfig
```kconfig
# SPDX-License-Identifier: GPL-2.0-only

config WCNSS_MEM_PRE_ALLOC
	tristate "WCNSS pre-alloc memory support"
	help
	  Pre-allocate memory for the WLAN driver module.
	  This feature enable cld wlan driver to use pre allocated memory
	  for it's internal usage and release it to back to pre allocated pool.
	  This memory is allocated at the cold boot time.

config CNSS_OUT_OF_TREE
	bool "Build module out-of-tree"
	help
	  This enables building the module out of the main kernel tree

config CNSS2_DEBUG
	bool "CNSS2 Platform Driver Debug Support"
	help
	  This option is to enable CNSS2 platform driver debug support which
	  primarily includes providing additional verbose logs for certain
	  features, enabling kernel panic for certain cases to aid the
	  debugging, and enabling any other debug mechanisms.

config CNSS_PREALLOC_DEBUG_LEAK
	bool "CNSS Prealloc Debug Leak Support"
	depends on WCNSS_MEM_PRE_ALLOC
	help
	  This option enables leakage debug for memory allocations
	  in the CNSS prealloc driver. When enabled, the driver will record
	  the call stack for each memory allocation, which can be
	  used for debugging memory leaks. This feature adds some memory
	  overhead and should only be enabled for debugging purposes.
```
