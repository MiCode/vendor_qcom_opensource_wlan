## platform/cnss2/autoghgvm_gki_defconfig
```kconfig
CONFIG_CNSS2=m
CONFIG_CNSS_OUT_OF_TREE=y
CONFIG_CNSS2_DEBUG=y
CONFIG_CNSS_PLAT_IPC_QMI_SVC=m
```

## platform/cnss2/autogvm_consolidate_defconfig
```kconfig
CONFIG_CNSS_OUT_OF_TREE=y
CONFIG_CNSS2=m
CONFIG_CNSS2_QMI=y
CONFIG_CNSS_PLAT_IPC_QMI_SVC=m
CONFIG_CNSS2_DEBUG=y
CONFIG_CNSS2_ENUM_WITH_LOW_SPEED=y
CONFIG_CNSS2_CONDITIONAL_POWEROFF=y
```

## platform/cnss2/sdxkova_gki_defconfig
```kconfig
CONFIG_CNSS2=m
CONFIG_CNSS_OUT_OF_TREE=y
CONFIG_CNSS2_QMI=y
CONFIG_CNSS_QMI_SVC=m
CONFIG_CNSS2_SSR_DRIVER_DUMP=y
CONFIG_CNSS_PLAT_IPC_QMI_SVC=m
CONFIG_WCNSS_MEM_PRE_ALLOC=m
CONFIG_CNSS2_DISABLE_SSR_RAMDUMP=y
```

## qcacld-3.0/configs/mango_defconfig
```kconfig
CONFIG_CNSS_KIWI := y
CONFIG_CNSS_KIWI_V2 := y
CONFIG_CNSS_MANGO := y
CONFIG_CNSS_EMULATION := y

include $(WLAN_ROOT)/configs/default_defconfig
```

## qcacld-3.0/configs/pineapple_consolidate_wcn6450_defconfig
```kconfig
CONFIG_DSC_DEBUG=y
CONFIG_WLAN_OBJMGR_DEBUG=y
CONFIG_LOCK_STATS_ON=y
CONFIG_WLAN_OBJMGR_REF_ID_TRACE=y
CONFIG_DESC_TIMESTAMP_DEBUG_INFO=y
CONFIG_FEATURE_UNIT_TEST_SUSPEND=y
CONFIG_LEAK_DETECTION=y
CONFIG_MAX_LOGS_PER_SEC=500
CONFIG_DP_FT_LOCK_HISTORY=y
CONFIG_DP_RX_REFILL_CPU_PERF_AFFINE_MASK=y
CONFIG_DP_TX_HW_DESC_HISTORY=y
CONFIG_DSC_TEST=y
CONFIG_ENABLE_QDF_PTR_HASH_DEBUG=y
CONFIG_FEATURE_HIF_LATENCY_PROFILE_ENABLE=y
CONFIG_HAL_DEBUG=y
CONFIG_HIF_CE_DEBUG_DATA_BUF=y
CONFIG_HIF_CPU_PERF_AFFINE_MASK=y
CONFIG_ENABLE_MAX_LOGS_PER_SEC=y
CONFIG_QDF_NBUF_HISTORY_SIZE=16384
CONFIG_REGISTER_OP_DEBUG=y
CONFIG_REO_QDESC_HISTORY=y
CONFIG_TALLOC_DEBUG=y
CONFIG_UNIT_TEST=y
CONFIG_WLAN_FEATURE_DP_TX_DESC_HISTORY=y
CONFIG_WLAN_RECORD_RX_PADDR=y
CONFIG_QDF_TEST=y
CONFIG_FEATURE_WLM_STATS=y
CONFIG_WLAN_TRACE_HIDE_MAC_ADDRESS_DISABLE=y
CONFIG_HIF_DEBUG=y
CONFIG_WLAN_WARN_ON_ASSERT=y
CONFIG_PANIC_ON_BUG=y
```

## qcacld-3.0/configs/qca6750_defconfig
```kconfig
CONFIG_CNSS_QCA6750 := y
$(warning "### DBG CONFIG_CNSS_QCA6750")
include $(WLAN_ROOT)/configs/default_defconfig

CONFIG_FEATURE_WLAN_CH_AVOID_EXT := y
CONFIG_WLAN_DDR_BW_MITIGATION := y
```
