// SPDX-License-Identifier: BSD-3-Clause
/*
 * Copyright (c) Qualcomm Technologies, Inc. and/or its subsidiaries.
 */

/dts-v1/;
/plugin/;

#include "chora-wcn6450.dtsi"

/ {
	model = "Qualcomm Technologies, Inc. Chora QRD evros";
	compatible = "qcom,chora-qrd", "qcom,chora", "qcom,chorap-qrd", "qcom,chorap", "qcom,qrd";
	qcom,msm-id = <724 0x10000>, <744 0x10000>;
	qcom,board-id = <0x1000b 0x0>, <0x1020b 0x0>;
};
