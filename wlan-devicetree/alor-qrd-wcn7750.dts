// SPDX-License-Identifier: BSD-3-Clause
/*
 * Copyright (c) Qualcomm Technologies, Inc. and/or its subsidiaries.
 */

/dts-v1/;
/plugin/;

#include "alor-wcn7750.dtsi"

/ {
	model = "Qualcomm Technologies, Inc. Alor QRD + WCN7750 WLAN";
	compatible = "qcom,alor-qrd", "qcom,alor", "qcom,qrd";
	qcom,msm-id = <685 0x10000>, <727 0x10000>;
	qcom,board-id = <0x1000B 0>, <0x1010B 0>;
};
