// SPDX-License-Identifier: BSD-3-Clause

/*
 * Copyright (c) Qualcomm Technologies, Inc. and/or its subsidiaries.
 */

/dts-v1/;
/plugin/;

#include "volcano-qca6750.dtsi"

/ {
	model = "Qualcomm Technologies, Inc. Volcano SoC";
	compatible = "qcom,volcano";
	qcom,msm-id = <636 0x10000>, <640 0x10000>, <0x4000291 0x10000>, <0x8000291 0x10000>,  <0xc000291 0x10000>, <0x10000291 0x10000>, <0x4000292 0x10000>, <0x8000292 0x10000>, <0xc000292 0x10000>, <0x10000292 0x10000>;
	qcom,board-id = <33 0>, <34 0>, <34 1>, <8 0>, <8 1>, <8 7>, <8 8>, <8 12>, <8 13>, <11 0>, <11 1>;
};
