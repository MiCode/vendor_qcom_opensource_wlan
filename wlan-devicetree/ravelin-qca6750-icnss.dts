// SPDX-License-Identifier: BSD-3-Clause

/*
 * Copyright (c) Qualcomm Technologies, Inc. and/or its subsidiaries.
 */

/dts-v1/;
/plugin/;

#include "ravelin-qca6750-icnss.dtsi"

/ {
	model = "Qualcomm Technologies, Inc. Montague MSL IDP";
	compatible = "qcom,montague-idp", "qcom,montague", "qcom,idp";
	qcom,msm-id = <581 0x10000>, <582 0x10000>;
	qcom,board-id = <0x10022 0x3>;
};
