// SPDX-License-Identifier: BSD-3-Clause
/*
 * Copyright (c) Qualcomm Technologies, Inc. and/or its subsidiaries.
 */

/dts-v1/;
/plugin/;

#include "kera-qca6750.dtsi"

/ {
	model = "Qualcomm Technologies, Inc. Kera ATP + MSL WLAN";
	compatible = "qcom,kera-atp", "qcom,kera", "qcom,atp", "qcom,kerap-qmb";
	qcom,msm-id = <686 0x10000>, <659 0x10000>, <720 0x10000>, <731 0x10000>,
			<732 0x10000>;
	qcom,board-id = <0x000021 0>;
};
