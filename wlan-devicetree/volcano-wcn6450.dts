// SPDX-License-Identifier: BSD-3-Clause

/*
 * Copyright (c) Qualcomm Technologies, Inc. and/or its subsidiaries.
 */

/dts-v1/;
/plugin/;

#include "volcano-wcn6450.dtsi"

/ {
	model = "Qualcomm Technologies, Inc. Volcano SoC";
	compatible = "qcom,volcano";
	qcom,board-id = <34 4>, <34 5>, <34 6>, <8 9>, <8 10>, <8 14>;
	qcom,msm-id = <636 0x10000>, <640 0x10000>, <641 0x10000>, <712 0x10000>, <0x4000291 0x10000>, <0x8000291 0x10000>, <0xc000291 0x10000>, <0x10000291 0x10000>, <0x4000292 0x10000>, <0x8000292 0x10000>, <0xc000292 0x10000>, <0x10000292 0x10000>;
};
