// SPDX-License-Identifier: BSD-3-Clause

/*
 * Copyright (c) Qualcomm Technologies, Inc. and/or its subsidiaries.
 */

/dts-v1/;
/plugin/;

#include "sun-peach-cnss-v8.dtsi"

/ {
	model = "Qualcomm Technologies, Inc. Sun SoCs";
	compatible = "qcom,sun", "qcom,sunp";
	qcom,msm-id = <618 0x10000>, <618 0x20000>,
		      <639 0x10000>, <639 0x20000>,
		      <0x100026a 0x10000>, <0x100026a 0x20000>,
		      <0x100027f 0x10000>, <0x100027f 0x20000>,
		      <705 0x10000>, <705 0x20000>,
		      <706 0x10000>, <706 0x20000>,
		      <0x10002c1 0x10000>, <0x10002c1 0x20000>,
		      <0x10002c2 0x10000>, <0x10002c2 0x20000>;
	qcom,board-id = <0x50001 0>, <0x40008 0>, <0x3000B 0>, <0x2000B 0>,
			<0x30008 0>, <0x40001 0>, <0x30015 0>, <0x60008 0>,
			<0x10021 0>, <0x3000B 1>, <0x40108 0>;
};
