// SPDX-License-Identifier: BSD-3-Clause
/*
 * Copyright (c) Qualcomm Technologies, Inc. and/or its subsidiaries.
 */

/dts-v1/;
/plugin/;

#include "alor-peach-cnss.dtsi"

/ {
	model = "Qualcomm Technologies, Inc. Alor CDP + Peach WLAN";
	compatible = "qcom,alor-cdp", "qcom,alor", "qcom,cdp";
	qcom,msm-id = <685 0x10000>, <727 0x10000>;
	qcom,board-id = <0x20001 0>;
};

