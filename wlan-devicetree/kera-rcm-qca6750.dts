// SPDX-License-Identifier: BSD-3-Clause
/*
 * Copyright (c) Qualcomm Technologies, Inc. and/or its subsidiaries.
 */

/dts-v1/;
/plugin/;

#include "kera-qca6750.dtsi"

/ {
	model = "Qualcomm Technologies, Inc. Kera RCM";
	compatible = "qcom,kera-rcm", "qcom,kera", "qcom,rcm", "qcom,kerap-qmb";
	qcom,msm-id = <686 0x10000>, <659 0x10000>, <720 0x10000>, <731 0x10000>,
			<732 0x10000>;
	qcom,board-id = <0x010015 0>, <0x020015 0>, <0x030015 0>;
};
