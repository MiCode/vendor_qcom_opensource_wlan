// SPDX-License-Identifier: BSD-3-Clause

/*
 * Copyright (c) Qualcomm Technologies, Inc. and/or its subsidiaries.
 */

/dts-v1/;
/plugin/;

#include "lahaina-qca6750-cnss.dtsi"

/ {
	model = "Qualcomm Technologies, Inc. YUPIK-IOT QRD";
	compatible = "qcom,yupik-iot-qrd", "qcom,yupik-iot", "qcom,qrd";
	qcom,msm-id = <497 0x10000>, <498 0x10000>, <575 0x10000>, <576 0x10000>;
	qcom,board-id = <0x1000B 0>, <34 0>;
};
