// SPDX-License-Identifier: BSD-3-Clause
/*
 * Copyright (c) Qualcomm Technologies, Inc. and/or its subsidiaries.
 */

/dts-v1/;
/plugin/;

#include "kera-qna-wcn7750.dtsi"

/ {
	model = "Qualcomm Technologies, Inc. Kera IDP";
	compatible = "qcom,kerap-qna";
	qcom,msm-id = <721 0x10000>;
	qcom,board-id = <0x020022 0>, <0x010022 0>;
};
