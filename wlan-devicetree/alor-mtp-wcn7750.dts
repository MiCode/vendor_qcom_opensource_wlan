// SPDX-License-Identifier: BSD-3-Clause
/*
 * Copyright (c) Qualcomm Technologies, Inc. and/or its subsidiaries.
 */

/dts-v1/;
/plugin/;

#include "alor-wcn7750.dtsi"

/ {
	model = "Qualcomm Technologies, Inc. Alor MTP + WCN7750 WLAN";
	compatible = "qcom,alor-mtp", "qcom,alor", "qcom,mtp";
	qcom,msm-id = <685 0x10000>, <727 0x10000>;
	qcom,board-id = <0x10008 0>, <0x20008 0>;
};
