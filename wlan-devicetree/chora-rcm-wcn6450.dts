// SPDX-License-Identifier: BSD-3-Clause
/*
 * Copyright (c) Qualcomm Technologies, Inc. and/or its subsidiaries.
 */

/dts-v1/;
/plugin/;

#include "chora-wcn6450.dtsi"

/ {
	model = "Qualcomm Technologies, Inc. Chora RCM evros";
	compatible = "qcom,chora-rcm", "qcom,chora", "qcom,chorap-rcm", "qcom,chorap", "qcom,rcm";
	qcom,msm-id = <724 0x10000>, <744 0x10000>;
	qcom,board-id = <0x10015 0x0>;
};
