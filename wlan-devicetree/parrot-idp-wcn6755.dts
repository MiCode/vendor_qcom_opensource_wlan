// SPDX-License-Identifier: BSD-3-Clause

/*
 * Copyright (c) 2024 Qualcomm Innovation Center, Inc. All rights reserved.
 */

/dts-v1/;
/plugin/;

#include "parrot-wcn6755.dtsi"

/ {
	model = "Qualcomm Technologies, Inc. Parrot WCN6755 IDP";
	compatible = "qcom,parrot", "qcom,parrot-idp", "qcom,idp";
	qcom,msm-id = <537 0x10000>, <583 0x10000>, <613 0x10000>, <631 0x10000>, <633 0x10000>, <634 0x10000>, <638 0x10000>, <663 0x10000>;
	qcom,board-id = <34 5>, <34 6>;
};
