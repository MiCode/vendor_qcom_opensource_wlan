// SPDX-License-Identifier: BSD-3-Clause
/*
 * Copyright (c) Qualcomm Technologies, Inc. and/or its subsidiaries.
 */

/dts-v1/;
/plugin/;

#include "chora-wcn7750.dtsi"

/ {
	model = "Qualcomm Technologies, Inc. Chora CDP wcn7750";
	compatible = "qcom,chora-cdp", "qcom,chora", "qcom,chorap-cdp", "qcom,chorap", "qcom,cdp";
	qcom,msm-id = <724 0x10000>, <744 0x10000>;
	qcom,board-id = <0x20001 0x0>;
};
