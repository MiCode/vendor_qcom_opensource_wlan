// SPDX-License-Identifier: BSD-3-Clause
/*
 * Copyright (c) Qualcomm Technologies, Inc. and/or its subsidiaries.
 */

/dts-v1/;
/plugin/;

#include "alor-peach-cnss.dtsi"

/ {
	model = "Qualcomm Technologies, Inc. Alor QRD + Peach WLAN";
	compatible = "qcom,alor-qrd", "qcom,alor", "qcom,qrd";
	qcom,msm-id = <685 0x10000>, <727 0x10000>;
	qcom,board-id = <0x2000B 0>;
};
