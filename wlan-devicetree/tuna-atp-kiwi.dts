// SPDX-License-Identifier: BSD-3-Clause
/*
 * Copyright (c) 2024 Qualcomm Innovation Center, Inc. All rights reserved.
 */

/dts-v1/;
/plugin/;

#include "tuna-kiwi-cnss.dtsi"

/ {
	model = "Qualcomm Technologies, Inc. Tuna ATP + kiwi WLAN";
	compatible = "qcom,tuna-atp", "qcom,tuna", "qcom,atp", "qcom,tunap-atp",
			"qcom,tunap";
	qcom,msm-id = <655 0x10000>, <681 0x10000>, <694 0x10000>;
	qcom,board-id = <33 0>;
};
