// SPDX-License-Identifier: BSD-3-Clause
//Copyright (c) Qualcomm Technologies, Inc. and/or its subsidiaries.
/dts-v1/;
/plugin/;

#include "sa525m-cnss.dtsi"

/ {
	model = "Qualcomm Technologies, Inc. SA525M";
	compatible = "qcom,sdxpinn";
	qcom,msm-id = <558 0x10000>, <559 0x10000>;
	qcom,board-id = <0 0>;
};
