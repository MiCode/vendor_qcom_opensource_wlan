// SPDX-License-Identifier: BSD-3-Clause
/*
 * Copyright (c) Qualcomm Technologies, Inc. and/or its subsidiaries.
 */

/dts-v1/;
/plugin/;

#include "kera-qna-qca6750.dtsi"

/ {
	model = "Qualcomm Technologies, Inc. Kera CDP";
	compatible = "qcom,kerap-qna";
	qcom,msm-id = <721 0x10000>;
	qcom,board-id = <0x010001 0>, <0x020001 0>, <0x030001 0>, <0x040001 0>, <0x50001 0>;
};
