// SPDX-License-Identifier: BSD-3-Clause

/*
 * Copyright (c) 2024 Qualcomm Innovation Center, Inc. All rights reserved.
 */

#include "sun-peach-cnss-v8.dtsi"

&wlan_peach {
	/delete-property/ vdd-wlan-ant-share-supply;
	/delete-property/ qcom,vdd-wlan-ant-share-config;
};
