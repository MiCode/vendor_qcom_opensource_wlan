// SPDX-License-Identifier: BSD-3-Clause
/*
 * Copyright (c) Qualcomm Technologies, Inc. and/or its subsidiaries.
 */

/dts-v1/;
/plugin/;

#include "alor-peach-cnss.dtsi"

/ {
	model = "Qualcomm Technologies, Inc. Alor ATP + Peach WLAN";
	compatible = "qcom,alor-atp", "qcom,alor", "qcom,atp";
	qcom,msm-id = <685 0x10000>, <727 0x10000>;
	qcom,board-id = <0x10021 0>;
};
