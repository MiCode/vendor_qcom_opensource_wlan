// SPDX-License-Identifier: BSD-3-Clause
/*
 * Copyright (c) Qualcomm Technologies, Inc. and/or its subsidiaries.
 */

/dts-v1/;
/plugin/;

#include "kera-wcn7750.dtsi"

/ {
	model = "Qualcomm Technologies, Inc. Kera MTP";
	compatible = "qcom,kera-mtp", "qcom,kera", "qcom,mtp", "qcom,kerap-qmb";
	qcom,msm-id = <686 0x10000>, <659 0x10000>, <720 0x10000>, <731 0x10000>,
			<732 0x10000>;
	qcom,board-id = <0x010008 1>, <0x020008 1>, <0x030008 1>;
};
