// SPDX-License-Identifier: BSD-3-Clause
/*
 * Copyright (c) Qualcomm Technologies, Inc. and/or its subsidiaries.
 */

/dts-v1/;
/plugin/;

#include "alor-wcn7750.dtsi"

/ {
	model = "Qualcomm Technologies, Inc. Alor CDP + WCN7750 WLAN";
	compatible = "qcom,alor-cdp", "qcom,alor", "qcom,cdp";
	qcom,msm-id = <685 0x10000>, <727 0x10000>;
	qcom,board-id = <0x10001 0>;
};
