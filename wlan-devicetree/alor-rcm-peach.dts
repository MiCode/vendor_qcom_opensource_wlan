// SPDX-License-Identifier: BSD-3-Clause
/*
 * Copyright (c) Qualcomm Technologies, Inc. and/or its subsidiaries.
 */

/dts-v1/;
/plugin/;

#include "alor-peach-cnss.dtsi"

/ {
	model = "Qualcomm Technologies, Inc. Alor RCM + Peach WLAN";
	compatible = "qcom,alor-rcm", "qcom,alor", "qcom,rcm";
	qcom,msm-id = <685 0x10000>, <727 0x10000>;
	qcom,board-id = <0x20015 0>;
};
