// SPDX-License-Identifier: BSD-3-Clause
/*
 * Copyright (c) Qualcomm Technologies, Inc. and/or its subsidiaries.
 */

/dts-v1/;
/plugin/;

#include "chora-wcn7750.dtsi"

/ {
	model = "Qualcomm Technologies, Inc. Chora QRD wcn7750";
	compatible = "qcom,chora-qrd", "qcom,chora", "qcom,chorap-qrd", "qcom,chorap", "qcom,qrd";
	qcom,msm-id = <724 0x10000>, <744 0x10000>;
	qcom,board-id = <0x2000b 0x0>, <0x2020b 0x0>;
};
